## drivers/misc/mediatek/xhci_test/Kconfig
```kconfig
#
# Mediatek XHCI Test Driver
#

config MTK_TEST_XHCI
	tristate "MediaTek U3 TEST XHCI driver support"
	default n
	---help---
	  Enables support Mediatek U3 XHCI test driver kernel framework.
	  If unsure, say N.
```
