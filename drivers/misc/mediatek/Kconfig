## drivers/misc/mediatek/Kconfig
```kconfig
menuconfig MEDIATEK_SOLUTION
	bool "MediaTek Properitary Configuration"
	help
	  Check this to enable MediaTek properity configuration.

if MEDIATEK_SOLUTION

config MTK_PLATFORM
	string "MTK platform name"

config ARCH_MTK_PROJECT
	string "MTK project name"

config MTK_INTERNAL
	bool "Enable MTK internal debug feature"
	help
	  Identify if codebase is built with MTK internal debug
	  (Don't modify this feature option setting.)

source "drivers/misc/mediatek/cirq/Kconfig"

source "drivers/misc/mediatek/systracker/Kconfig"

source "drivers/misc/mediatek/l2c_share/Kconfig"

config HAVE_XLOG_SUPPORT
	bool "HAVE_XLOG_SUPPORT"
	help
	  It decide whether the system has XLOG mechanism. XLOG is a log
	  filter mechanism which can filter the logs by tag before they are
	  written to log buffer

config HAVE_XLOG_PRINTK
	bool "HAVE_XLOG_PRINTK"
	help
	  It decide whether the system has kernel XLOG printk mechanism. XLOG is a log
	  filter mechanism which can filter the logs by tag before they are
	  written to log buffer

config FPGA_EARLY_PORTING
	bool "FPGA_EARLY_PORTING"
	help
	  Used for FPGA early porting to separate code segments between FPGA
	  platform and non-FPGA platform

config MTK_NEW_COMBO_EMMC_SUPPORT
	bool "MTK_NEW_COMBO_EMMC_SUPPORT"
	help
	  Add option for new combo-emmc

config MTK_SHARED_SDCARD
	bool "MTK_SHARED_SDCARD"
	help
	  sdcard will be a folder of /data

config MTK_MULTI_STORAGE_SUPPORT
	bool "MTK_MULTI_STORAGE_SUPPORT"
	help
	  Support more than 1 SD. Some write app can save to one of the
	  storages. Ex: Camera,recorder,browser,BT,ATV,CMMB.  Mount service
	  can mount multi-storage. And Media scanner will scan all storages.

config MTK_MULTI_PARTITION_MOUNT_ONLY_SUPPORT
	bool "MTK_MULTI_PARTITION_MOUNT_ONLY_SUPPORT"
	help
	  Enable/disable USB OTG to mount multi-partition USB disk

config MTK_SECURITY_SW_SUPPORT
	bool "Enable MTK SECURITY SW Support"
	default n
	help
	  If yes, All security function in preloader/LK/kernel/android will
	  be built into software images

source "drivers/misc/mediatek/trustzone/Kconfig"

config HAVE_TRUSTONIC_TEE_SUPPORT
	bool "Enable MTK TRUSTONIC TEE Solution"
	default n

#
# TRUSTONIC TEE configuration
#
config TRUSTONIC_TEE_SUPPORT
	bool "Enable Trustonic TEE Support"
	depends on HAVE_TRUSTONIC_TEE_SUPPORT
	default n
	---help---
	  Enable Trustonic TEE Support

config TRUSTONIC_TRUSTED_UI
	tristate "<t-base TUI"
	depends on MOBICORE_API
	default n
	---help---
	  Enable <t-base Trusted User Interface

config TRUSTONIC_TRUSTED_UI_FB_BLANK
	bool "<t-base TUI with fb_blank"
	depends on TRUSTONIC_TRUSTED_UI
	default n
	---help---
	  Blank the framebuffer before starting a TUI session

config MTK_SEC_VIDEO_PATH_SUPPORT
	bool "Enable MTK Secure Video Path Support"
	depends on (MTK_IN_HOUSE_TEE_SUPPORT) || (TRUSTONIC_TEE_SUPPORT)
	default n
	help
	  This enable MTK Secure Video Path Support. (depending on MTK In-House TEE Support or Trustonic TEE Support)

config MTK_THERMAL_STATUS_COLLECTION
	bool "MTK Thermal Status Information Collection"
	default n


config MD32_SUPPORT
	bool "Specifiy If Platform Support MD32"
	default n

config MTK_MEM
	bool "Support platform memory information"
	default y
	help

config MTK_MEMCFG
	bool "Support enhanced memory configurations"
	depends on MTK_MEM
	default n
	help

config MTK_DT_SUPPORT
	bool "MTK_DT_SUPPORT"
	default n

config MTK_TELEPHONY_BOOTUP_MODE_SLOT1
    int "MTK_TELEPHONY_BOOTUP_MODE_SLOT1"
    depends on EVDO_DT_SUPPORT
    default 0
    help
      EVDO devcie telephony slot1 boot up mode

config MTK_TELEPHONY_BOOTUP_MODE_SLOT2
    int "MTK_TELEPHONY_BOOTUP_MODE_SLOT2"
    depends on EVDO_DT_SUPPORT
    default 1
    help
      EVDO devcie telephony slot2 boot up mode

config MTK_SMARTBOOK_SUPPORT
	bool "MTK_SMARTBOOK_SUPPORT"
	help
	  Smartbook feature enables phone to connect with a smartbook
	  device. A smartbook device is something like a notebook, it has
	  screen, keyboard, touchpad, speaker, dual usb port, led light, yet
	  it doesn't have a internal storage, ram or CPU. Once smartbook-
	  feature-enabled phone is connected to a smartbook, all content on
	  phone screen is shown on smartbook screen, and user can operate
	  the phone via smartbook's keyboard, touchpad or plugged usb mouse.

config MTK_SENSOR_SUPPORT
	bool "MTK_SENSOR_SUPPORT"
	help
	  sensor config to sensor port sensor feature in project

config MTK_AUTO_DETECT_ACCELEROMETER
	bool "MTK_AUTO_DETECT_ACCELEROMETER"
	depends on MTK_SENSOR_SUPPORT
	help
	  one load to support different accelerometer sensor

config MTK_AUTO_DETECT_MAGNETOMETER
	bool "MTK_AUTO_DETECT_MAGNETOMETER"
	help
	  one load to support different magnetometer sensor

config MTK_AUTO_DETECT_ALSPS
	bool "MTK_AUTO_DETECT_ALSPS"
	help
	  This feature Option is used for projects which using more than one
	  ALSPS sensors, more than one ALSPS drivers can be builded in to
	  project and be auto detected by setting this option to yes

# Custom
config CUSTOM_KERNEL_ACCELEROMETER
	bool "CUSTOM_KERNEL_ACCELEROMETER"
	help
	  accelerometer sensor to detect accelerometer from x y z axis.

config CUSTOM_KERNEL_GYROSCOPE
	bool "CUSTOM_KERNEL_GYROSCOPE"
	help
	  gyroscope driver

config CUSTOM_KERNEL_ALSPS
	bool "CUSTOM_KERNEL_ALSPS"
	help
	  ALSPS sensor driverto detect ambint light and the object is close
	  or far awary from device

config CUSTOM_SEC_AUTH_SUPPORT
	bool "CUSTOM_SEC_AUTH_SUPPORT"
	help
	  Support customer to implement and apply their own RSA security
	  functions

config CUSTOM_KERNEL_MAGNETOMETER
	bool "CUSTOM_KERNEL_MAGNETOMETER"
	help
	  compass driver to detect compass raw data and report orientatino
	  data

config CUSTOM_KERNEL_BAROMETER
	bool "CUSTOM_KERNEL_BAROMETER"
	help
	  To detect barometer raw data

config MTK_SENSOR_HUB_SUPPORT
	bool "MTK_SENSOR_HUB_SUPPORT"
	help
	  To enable MTK sensor hub

config CUSTOM_KERNEL_SENSORHUB
	string "CUSTOM_KERNEL_SENSORHUB"
	help
	  Kernel space sensor hub driver. Define project used all sensor hub
	  sensors. The value is combination of sensor hub driver(get data...etc)
	  and sensor hub framework driver(transmit shf info)

config INPUT_CWSTM32
	bool "CONFIG_INPUT_CWSTM32"
	help
	  Cywee on STM32

config MTK_ICM30628
	bool "CONFIG_MTK_ICM30628"
	help
	  Invensense on ICM30628

config CUSTOM_KERNEL_STEP_COUNTER
	bool "CUSTOM_KERNEL_STEP_COUNTER"
	help
	  Kernel space step counter driver.

config CUSTOM_KERNEL_SIGNIFICANT_MOTION_SENSOR
	bool "CUSTOM_KERNEL_SIGNIFICANT_MOTION_SENSOR"
	help
	  Kernel space sigificant motion sensor driver.

config CUSTOM_KERNEL_ACTIVITY_SENSOR
	bool "CUSTOM_KERNEL_ACTIVITY_SENSOR"
	help
	  Kernel space activity sensor driver.

config CUSTOM_KERNEL_PICK_UP_SENSOR
	bool "CUSTOM_KERNEL_PICK_UP_SENSOR"
	help
	  Kernel space pick up sensor driver.

config CUSTOM_KERNEL_SHAKE_SENSOR
	bool "CUSTOM_KERNEL_SHAKE_SENSOR"
	help
	  Kernel space shake sensor driver.

config CUSTOM_KERNEL_FACE_DOWN_SENSOR
	bool "CUSTOM_KERNEL_FACE_DOWN_SENSOR"
	help
	  Kernel space face down sensor driver.

config CUSTOM_KERNEL_IN_POCKET_SENSOR
	bool "CUSTOM_KERNEL_IN_POCKET_SENSOR"
	help
	  Kernel space in pocket detection sensor driver.

config CUSTOM_KERNEL_PEDOMETER
	bool "CUSTOM_KERNEL_PEDOMETER"
	help
	  Kernel space pedometer sensor driver.

config CUSTOM_KERNEL_HEART_RATE_SENSOR
	bool "CUSTOM_KERNEL_HEART_RATE_SENSOR"
	help
	  Kernel space heart rate sensor driver.

config CUSTOM_KERNEL_HEART
	bool "CUSTOM_KERNEL_HEART"
	help
	  Kernel space heart rate sensor driver.

config CUSTOM_KERNEL_TILT_DETECTOR_SENSOR
	bool "CUSTOM_KERNEL_TILT_DETECTOR_SENSOR"
	help
	  Kernel space tilt detector sensor driver.

config CUSTOM_KERNEL_WAKE_GESTURE_SENSOR
	bool "CUSTOM_KERNEL_WAKE_GESTURE_SENSOR"
	help
	  Kernel space wake up gesture sensor driver.

config CUSTOM_KERNEL_GLANCE_GESTURE_SENSOR
	bool "CUSTOM_KERNEL_GLANCE_GESTURE_SENSOR"
	help
	  Kernel space glance(touch wake up) gesture sensor driver.

config CUSTOM_KERNEL_BRINGTOSEE_SENSOR
	bool "CUSTOM_KERNEL_BRINGTOSEE_SENSOR"
	help
	  Kernel space bring to see sensor driver.

config CUSTOM_KERNEL_GMRV_SENSOR
	bool "CUSTOM_KERNEL_GMRV_SENSOR"
	help
	  Kernel space geomagnetic rotation vector sensor driver.

config CUSTOM_KERNEL_RV_SENSOR
	bool "CUSTOM_KERNEL_RV_SENSOR"
	help
	  Kernel space rotation vector sensor driver.

config CUSTOM_KERNEL_GRV_SENSOR
	bool "CUSTOM_KERNEL_GRV_SENSOR"
	help
	  Kernel space game rotation vector sensor driver.

config CUSTOM_KERNEL_GRAVITY_SENSOR
	bool "CUSTOM_KERNEL_GRAVITY_SENSOR"
	help
	  Kernel space gravity sensor driver.

config CUSTOM_KERNEL_LINEARACCEL_SENSOR
	bool "CUSTOM_KERNEL_LINEARACCEL_SENSOR"
	help
	  Kernel space linear acceleration sensor driver.

config CUSTOM_KERNEL_IMGSENSOR
	string "CUSTOM_KERNEL_IMGSENSOR"
	help
	  Kernel space image sensor driver. Define  project used all image
	  sensors .The value is combination of CUSTOM_KERNEL_MAIN_IMGSENSOR,
	  CUSTOM_KERNEL_MAIN_BACKUP_IMGSENSOR, CUSTOM_KERNEL_SUB_IMGSENSOR,
	  and CUSTOM_KERNEL_SUB_BACKUP_IMGSENSOR

config CUSTOM_KERNEL_CAM_CAL_DRV
	string "CUSTOM_KERNEL_CAM_CAL_DRV"
	help
	  Kernel space camera calibration driver. Define  project used cam_cal
	  driver .

config CUSTOM_KERNEL_LCM
	string "CUSTOM_KERNEL_LCM"
	help
	  To choose kernel LCM driver name

config CUSTOM_KERNEL_FLASHLIGHT
	string "CUSTOM_KERNEL_FLASHLIGHT"
	help
	  Kernel space cameara flashlight driver. You can use this driver
	  choose cameara flashlight type.

config MTK_FORCE_CLUSTER1
	bool "MTK_FORCE_CLUSTER1"
	help
	  This option is used to forcing system to run on CPU cluster 1,
	  e.g. big cores on BIG.LITTLE system. MTK_FORCE_CLUSTER1 = "yes"
	  means enable this feature and "no" disable.

config MTK_HIBERNATION
	bool "MTK Hibernation support (IPOH)"
	depends on TOI
	default y
	---help---
	  MTK Hibernation is the improved hibernation
	  in kernel for IPOH.

config CUSTOM_KERNEL_CHARGEPUMP
	bool "CUSTOM_KERNEL_CHARGEPUMP"
	default n

config MTK_TC1_FEATURE
	bool "MTK_TC1_FEATURE"
	default n

config MTK_TC7_FEATURE
	bool "MTK_TC7_FEATURE"
	default n

config MTK_TC1_FM_AT_SUSPEND
	bool "MTK_TC1_FM_AT_SUSPEND"
	default n

source "drivers/misc/mediatek/Kconfig.kernel"
source "drivers/misc/mediatek/Kconfig.drivers"
source "drivers/misc/mediatek/smartpa/Kconfig"

 
source "drivers/misc/mediatek/lastpc/Kconfig"
source "drivers/misc/mediatek/fmradio/Kconfig"
source "drivers/misc/mediatek/hwmon/Kconfig"
source "drivers/misc/mediatek/cmdq/Kconfig"
source "drivers/misc/mediatek/videox/Kconfig"
source "drivers/misc/mediatek/mt_logger/Kconfig"
source "drivers/misc/mediatek/btif/Kconfig"
source "drivers/misc/mediatek/conn_md/Kconfig"
source "drivers/misc/mediatek/lens/Kconfig"
source "drivers/misc/mediatek/imgsensor/Kconfig"
source "drivers/misc/mediatek/cam_cal/Kconfig"
source "drivers/misc/mediatek/flashlight/Kconfig"
source "drivers/misc/mediatek/dum-char/Kconfig"
source "drivers/misc/mediatek/sysenv/Kconfig"
source "drivers/misc/mediatek/partition/Kconfig"
source "drivers/misc/mediatek/smi/Kconfig"
source "drivers/misc/mediatek/btcvsd/Kconfig"
source "drivers/misc/mediatek/sound/Kconfig"
source "drivers/misc/mediatek/spm/Kconfig"
source "drivers/misc/mediatek/power_gs/Kconfig"
source "drivers/misc/mediatek/video/Kconfig"
source "drivers/misc/mediatek/mrdump/Kconfig"
source "drivers/misc/mediatek/wmt_ccci/Kconfig"
source "drivers/misc/mediatek/vcorefs/Kconfig"
source "drivers/misc/mediatek/emi_mpu/Kconfig"
source "drivers/misc/mediatek/emi_bwl/Kconfig"
source "drivers/misc/mediatek/pmic_wrap/Kconfig"
source "drivers/misc/mediatek/power/Kconfig"
source "drivers/misc/mediatek/rtc/Kconfig"
source "drivers/misc/mediatek/gpio/Kconfig"
source "drivers/misc/mediatek/uart/Kconfig"
source "drivers/misc/mediatek/dbg_dump/Kconfig"
source "drivers/misc/mediatek/connectivity/Kconfig"
source "drivers/misc/mediatek/gps/Kconfig"
source "drivers/misc/mediatek/nfc/Kconfig"
source "drivers/misc/mediatek/i2c/Kconfig"
source "drivers/misc/mediatek/keypad/Kconfig"
source "drivers/misc/mediatek/leds/Kconfig"
source "drivers/misc/mediatek/pwm/Kconfig"
source "drivers/misc/mediatek/irtx/Kconfig"
source "drivers/misc/mediatek/auxadc/Kconfig"
source "drivers/misc/mediatek/spi/Kconfig"
source "drivers/misc/mediatek/mmc-host/Kconfig"
source "drivers/misc/mediatek/power-loss-test/Kconfig"
source "drivers/misc/mediatek/mjc/Kconfig"
source "drivers/misc/mediatek/vdec/Kconfig"
source "drivers/misc/mediatek/videocodec/Kconfig"
source "drivers/misc/mediatek/multibridge/Kconfig"
source "drivers/misc/mediatek/sync/Kconfig"
source "drivers/misc/mediatek/mlog/Kconfig"
source "drivers/misc/mediatek/nand/Kconfig"
source "drivers/misc/mediatek/m4u/Kconfig"
source "drivers/misc/mediatek/boot/Kconfig"
source "drivers/misc/mediatek/boot_reason/Kconfig"
source "drivers/misc/mediatek/chip/Kconfig"
source "drivers/misc/mediatek/bthid/Kconfig"
 
source "drivers/misc/mediatek/gud/Kconfig"
source "drivers/misc/mediatek/gpu/Kconfig"
source "drivers/misc/mediatek/sw_tx_power/Kconfig"
source "drivers/misc/mediatek/jpeg/Kconfig"
source "drivers/misc/mediatek/devapc/Kconfig"
source "drivers/misc/mediatek/devinfo/Kconfig"
source "drivers/misc/mediatek/sched/Kconfig"
source "drivers/misc/mediatek/lcm/Kconfig"
source "drivers/misc/mediatek/ccci_util/Kconfig"
source "drivers/misc/mediatek/ccmni/Kconfig"
source "drivers/misc/mediatek/dual_ccci/Kconfig"
source "drivers/misc/mediatek/eccci/Kconfig"
source "drivers/misc/mediatek/eemcs/Kconfig"
source "drivers/misc/mediatek/ssw/Kconfig"
source "drivers/misc/mediatek/usb20/Kconfig"
source "drivers/misc/mediatek/usb11/Kconfig"
source "drivers/misc/mediatek/mu3d/Kconfig"
source "drivers/misc/mediatek/mu3phy/Kconfig"
source "drivers/misc/mediatek/xhci/Kconfig"
source "drivers/misc/mediatek/xhci_test/Kconfig"
source "drivers/misc/mediatek/eint/Kconfig"
source "drivers/misc/mediatek/cqdma/Kconfig"
source "drivers/misc/mediatek/watchpoint/Kconfig"
source "drivers/misc/mediatek/freqhopping/Kconfig"
source "drivers/misc/mediatek/aee/Kconfig"
source "drivers/misc/mediatek/ram_console/Kconfig"
source "drivers/misc/mediatek/atf_log/Kconfig"
source "drivers/misc/mediatek/mmp/Kconfig"
endif
```

## drivers/misc/mediatek/aee/Kconfig
```kconfig
config HAVE_AEE_FEATURE
	bool "HAVE_AEE_FEATURE"
	help
	  AEE (Android Exception Engine) that designed by  Mediatek is an
	  exception catching and debugging information generation mechanism.
	  It can collect and dump information to filesystem
	  (/sdcard/mtklog/aee_exp)  when fatel occur(E.g. kernel
	  panic/android system server crash and ..)

config MTK_AEE_FEATURE
	tristate "Enable Android Exception Enhancement"
	default n
	select FIQ_GLUE if !TRUSTONIC_TEE_SUPPORT && !ARM_PSCI
	---help---
	  Enable Android Exception Enhancement

config MTK_AEE_AED
	tristate "Enable AEE Kernel Exception Report Daemon"
	default y

config MTK_AEE_IPANIC
	tristate "Enable AEE Kernel Panic Dump"
	default y

config MTK_AEE_POWERKEY_HANG_DETECT
	bool "powerkey monitor"
	default n
```

## drivers/misc/mediatek/atf_log/Kconfig
```kconfig
config MTK_ATF_LOGGER
	bool "atf logger kernel part"
	depends on ARM_PSCI || ARM64 
```

## drivers/misc/mediatek/bthid/Kconfig
```kconfig
config KEYBOARD_HID
	tristate "Mediatek HID"
	default n
	depends on HID
	help
	  uhid driver provided by Mediatek.
	  Say Y if you want to use Mediatek HID to parse reports. 
```

## drivers/misc/mediatek/cqdma/Kconfig
```kconfig
config MTK_CQDMA
  bool "Enable MTK CQDMA Driver"
  default y
  help
     This enable MTK cqdma driver.
```

## drivers/misc/mediatek/devapc/Kconfig
```kconfig
config MTK_DEVAPC_DRIVER
	bool "Enable MTK Device APC driver"
	default y
	help
	  Device APC is a kernel driver controlling internal device security
```
