## drivers/misc/mediatek/eccci/Kconfig
```kconfig
config MTK_ECCCI_DRIVER
	tristate "ECCCI Driver"
	depends on MTK_CCCI_DEVICES
	default n
	---help---
	  This option enables ECCCI device driver support

config MTK_ECCCI_CLDMA
	tristate "ECCCI CLDMA driver"
	depends on MTK_ECCCI_DRIVER
	default y
	---help---
	  This option enables ECCCI CLDMA driver

config MTK_ECCCI_CCIF
	tristate "ECCCI CCIF driver"
	depends on MTK_ECCCI_DRIVER
	default n
	---help---
	  This option enables ECCCI CCIF driver

config MTK_ECCCI_UT
	tristate "ECCCI UT mode"
	depends on MTK_ECCCI_DRIVER
	default n
	---help---
	  This option enables ECCCI UT mode (software loopback, no CLDMA support)


config MTK_C2K_SUPPORT
	bool "MTK_C2K_SUPPORT"
	depends on !ARCH_MT6735M
	default n
	help
	  To support C2K modem
	
config EVDO_DT_SUPPORT
	bool "EVDO_DT_SUPPORT"
	depends on MTK_C2K_SUPPORT
	default n
	help
	  To support CDMA+GSM dual talk feature
	  
config MTK_SVLTE_SUPPORT
	bool "MTK_SVLTE_SUPPORT"
	depends on MTK_C2K_SUPPORT
	default n
	help
	  To support SVLTE feature

config EVDO_DT_VIA_SUPPORT
	bool "EVDO_DT_VIA_SUPPORT"
	depends on MTK_C2K_SUPPORT
	default n
	help
	  To support VIA CBP modem
```

## drivers/misc/mediatek/eemcs/Kconfig
```kconfig
# EEMCS
menuconfig MTK_EMCI_DEVICES # Use by MT6290M over SDIO
	bool "EMCI Devices"
	default n
	---help---
	  Say Y here to get to see options for device drivers from EEMCS.
	  If you say N, all options in this submenu will be skipped and disabled.

config MTK_EEMCS_DRIVER # EEMCS_DRIVER
	tristate "EEMCS Driver"
	depends on MTK_EMCI_DEVICES
	default y
	---help---
	  This option enables EEMCS device driver support

config MTK_ENABLE_MD5
	bool "MTK_ENABLE_MD5"
	depends on MTK_EEMCS_DRIVER
	default y
	help
	  Enable/Disable External Modem 5 (LTE modem)

config MTK_MD5_SUPPORT
	int "MTK_MD5_SUPPORT"
	depends on MTK_ENABLE_MD5
	default 5
	range 0 7
	help
	  modem 5 mode, value range(0-7):0(invalid),1(2g),2(3g),3(wg),4(tg)

config MD5_SMEM_SIZE
	hex "MD5_SMEM_SIZE"
	depends on MTK_ENABLE_MD5
	default 0x200000
	help
	  modem 5 share memory size.

config MD5_SIZE
	hex "MD5_SIZE"
	depends on MTK_ENABLE_MD5
	default 0xd00000
	help
	  modem 5 image size.

# CCCI refine Done
```

## drivers/misc/mediatek/eint/Kconfig
```kconfig
config MTK_EINT
  bool "Enable MTK EINT Driver"
  default y
  help
     This enable MTK eint driver.
```

## drivers/misc/mediatek/freqhopping/Kconfig
```kconfig
config MTK_FREQ_HOPPING
	bool "Enable MTK frequency hopping controler driver"
	default y
	help
        Frequencey hopping controller provides spread spectrum and frequency
        hopping on PLLs to prevent RF desense problems. Frequency hopping driver
        provides APIs for controling spread spectrum and frequency hopping on
        PLLs.
```

## drivers/misc/mediatek/mlog/Kconfig
```kconfig
config MTK_MLOG
	bool "Support memory log"
	default n
	help
          log memory info to kernel buffer.
```

## drivers/misc/mediatek/mu3d/Kconfig
```kconfig
#
# MediaTek USB 3.0 Controller Driver
#

config USBIF_COMPLIANCE
        tristate "MediaTek MUSB U3 USBIF COMPLIANCE"
        default n

config USB_MU3D_PIO_ONLY
	tristate "MediaTek MUSB Gadget support EP0 PIO mode"
	default n

config USB_MU3D_DRV
	tristate "MediaTek MUSB Gadget support"
	default n

config USB_MU3D_DVT
	tristate "MediaTek MUSB Gadget support"
	default n
```

## drivers/misc/mediatek/mu3phy/Kconfig
```kconfig
#
# USB3.0 PHY
#

config MU3_PHY
	bool "MU3 PHY"
	default n
	---help---
	  Enables support MU3 PHY for SSUSB or XHCI.
	  If unsure, say N.

config U3_PHY_GPIO_SUPPORT
	bool "MU3 PHY registers access by I2C"
	depends on MU3_PHY
	default n
	---help---
	  Enables support for read/write PHY registers by external I2C.
	  If unsure, say N.

config PROJECT_PHY
	bool "MU3 ASIC PHY support"
	depends on MU3_PHY
	default n
	---help---
	  Enables support for ASIC PHY.
	  If unsure, say N.

config U3_PHY_AHB_SUPPORT
	bool "MU3 PHY registers access by AHB"
	depends on MU3_PHY
	default n
	---help---
	  Enables support for read/write PHY registers by internal AHB.
	  If unsure, say N.

config C60802_SUPPORT
	bool "MU3 PHY C60802 support"
	depends on MU3_PHY
	default n
	---help---
	  Enables support for external PHY(Ver C).
	  If unsure, say N.

config D60802_SUPPORT
	bool "MU3 PHY D60802 support"
	depends on MU3_PHY
	default n
	---help---
	  Enables support for external PHY(Ver D).
	  If unsure, say N.

config E60802_SUPPORT
	bool "MU3 PHY E60802 support"
	depends on MU3_PHY
	default n
	---help---
	  Enables support for external PHY(Ver E).
	  If unsure, say N.
```

## drivers/misc/mediatek/nand/Kconfig
```kconfig
#nand
menuconfig MTK_MTD_NAND
        tristate "MediaTek Nand Support"
        depends on MTD_NAND
        ---help---
          Enables support for NAND Flash chips wired to MediaTek chips.

config MTK_MTD_NAND_INTERRUPT_SCHEME
        bool "Nand Read/Write with interrupt scheme"
        depends on MTK_MTD_NAND
        default n
        ---help---
          Enable interrupt scheme in Nand Read/Write.

config MTK_MLC_NAND_SUPPORT
  tristate "Mediatek MLC NAND Support"
  depends on MTK_MTD_NAND
  ---help---
          Enables support for MLC NAND.

config MTK_COMBO_NAND_SUPPORT
  tristate "Mediatek COMBO NAND Support"
  depends on MTK_MTD_NAND
  ---help---
          Enables support for COMBO NAND.

config MTK_FAT_ON_NAND
  tristate "Mediatek FAT on NAND Support"
  depends on MTK_MTD_NAND
  ---help---
          Enables support for FAT on NAND.

config MTK_FACTORY_RESET_PROTECTION_SUPPORT
  bool "Mediatek FRP Support"
  depends on MTK_MTD_NAND
  ---help---
          Enables support for FRP on NAND.
```

## drivers/misc/mediatek/pmic_wrap/Kconfig
```kconfig
if MTK_LDVT
config MTK_LDVT_PMIC_WRAP
	bool "MediaTek PMIC_WRAP driver for LDVT"
	default n
	---help---
	  MediaTek PMIC_WRAP driver for LDVT
endif

config MTK_PMIC_WRAP
	bool "MediaTek PMIC_WRAP driver"
	default y
	---help---
	  MediaTek PMIC_WRAP driver
```

## drivers/misc/mediatek/power/Kconfig
```kconfig
# Power Related
if POWER_SUPPLY
config MT6326_PMIC
	tristate "MediaTek PMIC Driver"
	depends on ARCH_MT6516
	default y
	---help---
          MediaTek PMIC 6326 Driver

config MTK_PMIC
	tristate "MediaTek Power Management Unit Driver"
	default y
	---help---
	  Mediatek PMIC Driver

config MTK_DUMMY_BATTERY
	tristate "MediaTek Dummy Battery Driver"
	depends on ARCH_MT6516
	default n
	---help---
	   Use Dummy Battery

config MTK_PMU
	tristate "MediaTek Power Management Unit Driver"
	depends on ARCH_MT6573
	default y
	---help---
	  Use Mediatek PMU

endif #POWER_SUPPLY

if MTK_LDVT
config MTK_LDVT_PMIC
	bool "MediaTek PMIC driver for LDVT"
	default y
	---help---
	  MediaTek PMIC driver for LDVT
endif
```

## drivers/misc/mediatek/ram_console/Kconfig
```kconfig
config MTK_RAM_CONSOLE
	bool "mt ram console" 

config MTK_RAM_CONSOLE_USING_SRAM
	bool "Using SRAM as ram console storage"
	depends on MTK_RAM_CONSOLE

config MTK_RAM_CONSOLE_USING_DRAM
	bool "Using DRAM as ram console storage"
	depends on MTK_RAM_CONSOLE

config MTK_RAM_CONSOLE_SIZE
	hex "MTK RAM console  address"
	default 0
	depends on MTK_RAM_CONSOLE

config MTK_RAM_CONSOLE_ADDR
	hex "MTK RAM console buffer size"
	default 0
	depends on MTK_RAM_CONSOLE   

config MTK_RAM_CONSOLE_DRAM_SIZE
	hex "MTK RAM console dram address"
	default 0
	depends on MTK_RAM_CONSOLE

config MTK_RAM_CONSOLE_DRAM_ADDR
	hex "MTK RAM console dram size"
	default 0
	depends on MTK_RAM_CONSOLE   
```

## drivers/misc/mediatek/sched/Kconfig
```kconfig
config MT_SCHED
	bool "Enhance CPU affinity in hotplug"	
 	depends on HOTPLUG
	default y
	help
	  The CPU affinity library for Hotplug enhancement is to achieve set CPU 
	  affinity without take care kernel behavior and to avoid affect the original
	  Linux design.
	  
config MT_PRIO_TRACER
	bool "Record priority changes"
	default n
	help
	  Export device node under debugfs/prio_tracer
	  
config MTK_SCHED_RQAVG_US
	bool "Enable runqueue staticsic calculation used in user space operation"
	depends on SMP && HIGH_RES_TIMERS
	default n
	help
	  TLP estimation for user space CPUfreq governors

config MTK_SCHED_RQAVG_KS
	bool "Enable runqueue staticsic calculation used in kernel space operation"
	depends on SMP
	default n
	help
	  TLP estimation for kernel space CPUfreq governors, e.g., hotplug
```

## drivers/misc/mediatek/sw_tx_power/Kconfig
```kconfig
config MTK_SWITCH_TX_POWER
	bool "EANBLE TX POWER SWITCH"
	default n
	---help---
	  MediaTek SWTP driver
```

## drivers/misc/mediatek/usb11/Kconfig
```kconfig
#
# MediaTek ICUSB Driver
#

config MTK_USBFSH # USBFSH
	bool "MediaTek USB fullspeed Host driver"
	default n

config MTK_ICUSB_SUPPORT
	bool "MTK_ICUSB_SUPPORT"
	default n
	help
	  To enable the ICUSB featurea in phone which support USB port 1

config MTK_DT_USB_SUPPORT
	bool "MTK_DT_USB_SUPPORT"
	default n
	help
	  To enable the dual talk feature in phone over USB port 1
```

## drivers/misc/mediatek/usb20/Kconfig
```kconfig
#
# USB Dual Role (OTG-ready) Controller Drivers
# for silicon based on Mentor Graphics INVENTRA designs
#

# (M)HDRC = (Multipoint) Highspeed Dual-Role Controller
#
#

config MTK_MUSB_QMU_SUPPORT
	bool "QMU Transfer mode of MediaTek MUSB"
	default n

config USB_MTK_ACM_TEMP
	tristate "MediaTek USB ACM Temp support"
	default y

config USB_MTK_HDRC
	tristate "MediaTek MUSB support"
	select USB_GADGET_SELECTED
	select USB_GADGET_DUALSPEED
	default y

config USB_MTK_HDRC_GADGET
	 tristate "MediaTek MUSB Gadget support"

config USB_MTK_OTG
	tristate "MediaTek MUSB OTG support"

config USB_MTK_DUALMODE
	bool "MediaTek DUAL MODE support"
	default n

config USB_MTK_DEBUG_FS
	tristate "MediaTek MUSB Debug FS support"
	depends on DEBUG_FS

config USB_MTK_DEBUG
	 tristate "MediaTek MUSB Debug support"

config USB_MTK_HDRC_HCD
	 tristate "MediaTek USB HDRC support"

config MTK_USB_UNIQUE_SERIAL
	 tristate "MediaTek USB unique serial number"

config MTK_USBFSH # USBFSH
	bool "MediaTek USB fullspeed Host driver"
	default n

config MUSBFSH_PIO_ONLY
	bool "Transfer mode of MediaTek USB fullspeed Host driver"
	default n

config MTK_UART_USB_SWITCH
	bool "MTK_UART_USB_SWITCH"
	help
	  Support share USB DP/DM as UART TX/RX.

# USB # TODO Check Choice
config MTK_USB_GADGET # USB_GADGET_MT6516 USB_GADGET_MT6573
	boolean "MediaTek USB Gadget Driver"
	select USB_GADGET_SELECTED
	select USB_GADGET_DUALSPEED
	default y
```

## drivers/misc/mediatek/watchpoint/Kconfig
```kconfig
config MTK_WATCHPOINT
  bool "Enable MTK WATCH POINTER Driver"
  default y
  help
     This enable MTK watch pointer driver.
```

## drivers/misc/mediatek/xhci/Kconfig
```kconfig
#
# Mediatek XHCI Driver
#

config MTK_XHCI
	tristate "MediaTek U3 XHCI support"
	default n
	---help---
	  Enables support Mediatek U3 XHCI functions.
	  If unsure, say N.

config MTK_OTG_PMIC_BOOST_5V
	tristate "MediaTek PMIC BOOST 5V support"
	default n
	---help---
	  Enables support PMIC BOOST 5V to be supply usb 5v power.
	  If unsure, say N.

config MTK_OTG_OC_DETECTOR
	tristate "MediaTek Over Current Detector"
	default n
	---help---
	  Enables support SW over current detect, if happen, cut down the 5V power.
	  If unsure, say N.
```
